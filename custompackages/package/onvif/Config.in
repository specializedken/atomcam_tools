## custompackages/package/onvif/Config.in
```kconfig
config BR2_PACKAGE_ONVIF
	bool "onvif"
	help
	  Minimal ONVIF Device/Media/PTZ service for AtomSwing cams.
	  Translates ONVIF SOAP into the atomcam_tools motor command socket.
	  Started only when ONVIF_ENABLE=on in hack.ini.
```
